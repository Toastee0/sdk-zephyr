/*
 * Copyright (c) 2024 Nordic Semiconductor ASA
 *
 * SPDX-License-Identifier: Apache-2.0
 */
#include <zephyr/dt-bindings/memory-attr/memory-attr.h>

/ {
	reserved-memory {
		cpuapp_data: memory@20000000 {
			reg = <0x20000000 DT_SIZE_K(1504)>;
		};

		cpuapp_dma_region: memory@20178000 {
			compatible = "zephyr,memory-region";
			reg = <0x20178000 DT_SIZE_K(32)>;
			status = "okay";
			#memory-region-cells = <0>;
			zephyr,memory-region = "DMA_RAM";
			zephyr,memory-attr = <( DT_MEM_DMA | DT_MEM_CACHEABLE )>;
		};
	};
};
